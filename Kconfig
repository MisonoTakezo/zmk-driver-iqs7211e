## Kconfig
```kconfig
menuconfig IQS7211E
    bool "IQS7211E capcacitive touch sensor"
  select I2C
    help
      Enable IQS7211E capcacitive touch sensor.
```

## dts/bindings/azoteq,iqs7211e.yaml
```yaml
# Copyright 2025 sekigon-gonnoc
# SPDX-License-Identifier: GPL-2.0 or later

description: IQS7211E capacitive touch sensor

compatible: "azoteq,iqs7211e"

include: i2c-device.yaml

properties:
  irq-gpios:
    type: phandle-array
    required: true
    description:
      GPIO connected to the motion pin, active low.

  power-gpios:
    type: phandle-array
    required: false
    description:
      GPIO connected to the power control pin.
```
